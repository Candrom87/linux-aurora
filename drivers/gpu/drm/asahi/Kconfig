## drivers/gpu/drm/asahi/Kconfig
```kconfig
# SPDX-License-Identifier: GPL-2.0

config RUST_DRM_SCHED
	bool
	select DRM_SCHED

config RUST_DRM_GPUVM
	bool
	select DRM_GPUVM

config DRM_ASAHI
	tristate "Asahi (DRM support for Apple AGX GPUs)"
	depends on RUST
	depends on DRM=y
	depends on (ARM64 && ARCH_APPLE) || (COMPILE_TEST && !GENERIC_ATOMIC64)
	depends on MMU
	depends on IOMMU_SUPPORT
	depends on PAGE_SIZE_16KB
	select APPLE_PMP_REPORT
	select RUST_DRM_SCHED
	select RUST_DRM_GEM_SHMEM_HELPER
	select RUST_DRM_GPUVM
	select RUST_APPLE_RTKIT
	help
	  DRM driver for Apple AGX GPUs (G13x, found in the M1 SoC family)

config DRM_ASAHI_DEBUG_ALLOCATOR
	bool "Use debug allocator"
	depends on DRM_ASAHI
	help
	  Use an alternate, simpler allocator which significantly reduces
	  performance, but can help find firmware- or GPU-side memory safety
	  issues. However, it can also trigger firmware bugs more easily,
	  so expect GPU crashes.

	  Say N unless you are debugging firmware structures or porting to a
	  new firmware version.

config DRM_ASAHI_UAT_ADOPTION
	bool
	help
	  The firmware UAT handoff adoption shared by the G15 backend and the
	  T8122 runtime (g15/uat.rs, g15/regs.rs).

config DRM_ASAHI_M3_T8122
	bool "M3 MacBook Air GPU runtime (T8122, 14.8.3 firmware)"
	depends on DRM_ASAHI
	# The runtime adopts the firmware's UAT as the G15 backend does, without
	# needing that backend: M3 Pro/Max keep their own setting.
	# Its PMP votes call apple-pmp directly (m3_device.rs).
	depends on APPLE_PMP=y || (APPLE_PMP=m && DRM_ASAHI=m)
	select DRM_ASAHI_UAT_ADOPTION
	select APPLE_T8122_GPU_PMP_LINK
	select CRYPTO_LIB_SHA256
	default n
	help
	  Build the M3 runtime that starts the GPU of the M3 MacBook Air
	  (J613, J615) on the 14.8.3 GPU firmware the boot loader leaves
	  loaded. On the listed Air boards it starts after the boot loader
	  handed the GPU over and resource/firmware identity checks pass.
	  asahi.t8122_start=0 keeps startup disabled for recovery. Unknown
	  boards and firmware do not gain automatic admission. Other GPUs
	  are not affected.

config DRM_ASAHI_G15
	bool "Native G15 firmware backend (M3 Pro/Max)"
	depends on DRM_ASAHI
	depends on DRM_APPLE=y || (DRM_APPLE=m && DRM_ASAHI=m)
	select APPLE_T6030_GPU_PMP_LINK
	select CRYPTO_LIB_SHA256
	select DRM_ASAHI_UAT_ADOPTION
	default n
	help
	  Enable the native G15 backend for explicitly admitted M3 Pro/Max
	  firmware and boards. Other GPUs keep the maintained backend.
	  The firmware session is retained until reboot once started.
	  The native display driver must be built in, or both drivers must
	  be modules, so a modular display provider finishes initialization
	  before the GPU module can probe through its direct helper import.

config DRM_ASAHI_G15_NATIVE_POWER
	bool "G15C explicit-input native board arithmetic"
	depends on DRM_ASAHI_G15 && ARM64 && KERNEL_MODE_NEON
	depends on ARCH_HAS_KERNEL_FPU_SUPPORT
	default n
	help
	  Build the source-scoped 23J220 arithmetic and board-packet producer.
	  CPU floating point is isolated behind a process-context ownership API.
	  This does not enable any GPU, acquire device inputs, or qualify a board.

config DRM_ASAHI_G15_BOARD_KUNIT_TEST
	bool "Test G15 native board metadata with KUnit"
	depends on KUNIT && DRM_ASAHI=y && DRM_ASAHI_G15 && OF_DYNAMIC
	depends on DRM_ASAHI_G15_NATIVE_POWER
	default n
	help
	  Exercise the real OF property reader and synchronous T6034 board-image
	  preflight using synthetic metadata in the marked QEMU handoff fixture.
	  No GPU registers, firmware, power operations or workloads are used.
	  The test skips on other machines. Say N outside metadata testing.

config DRM_ASAHI_G15_POWER_KUNIT_TEST
	bool "Test G15 native arithmetic ownership with KUnit"
	depends on KUNIT && DRM_ASAHI=y && DRM_ASAHI_G15_NATIVE_POWER && OF
	default n
	help
	  Run explicit-input arithmetic and SRAM/cap import through the actual
	  Linux FPU ownership API in the marked QEMU metadata fixture. Checks
	  atomic failures and IRQ-disabled/atomic/nested-context refusal as well.
	  No GPU device, registers, firmware or power operation is used.
	  The test skips on other machines. Say N outside CPU testing.
```
